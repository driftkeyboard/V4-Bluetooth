## boards/shields/drift/Kconfig.shield
```kconfig
config SHIELD_DRIFT_LEFT
    def_bool $(shields_list_contains,drift_left)

config SHIELD_DRIFT_RIGHT_CENTRAL
    def_bool $(shields_list_contains,drift_right_central)
```

## config/west.yml
```yaml
manifest:
  remotes:
    - name: driftkeyboard
      url-base: https://github.com/driftkeyboard
      
  projects:
    - name: zmk
      remote: driftkeyboard
      revision: v0.3.0
      import: app/west.yml
    - name: zmk-pmw3610-driver-badjeff
      remote: driftkeyboard
      revision: main
  self:
    path: config
```
